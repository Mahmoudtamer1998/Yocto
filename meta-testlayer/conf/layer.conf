## meta-testlayer/conf/layer.conf
```bitbake
# We have a conf and classes directory, add to BBPATH
BBPATH .= ":${LAYERDIR}"

# We have recipes-* directories, add to BBFILES
BBFILES += "${LAYERDIR}/recipes-*/*/*.bb \
            ${LAYERDIR}/recipes-*/*/*.bbappend"

BBFILE_COLLECTIONS += "meta-testlayer"
BBFILE_PATTERN_meta-testlayer = "^${LAYERDIR}/"
BBFILE_PRIORITY_meta-testlayer = "6"

LAYERDEPENDS_meta-testlayer = "core"
LAYERSERIES_COMPAT_meta-testlayer = "nanbield"
```
